## badge/sample.yaml
```yaml
sample:
  name: DCFurs Bluetooth Firmware
tests:
  sample.bluetooth.scan_adv:
    harness: bluetooth
    platform_whitelist: qemu_cortex_m3 qemu_x86
    tags: bluetooth
```

## boards/arm/dcfurs_bt832a/Kconfig.board
```kconfig
# Kconfig - DCFurs BT832A board configuration
#
# Copyright (c) 2018 Nordic Semiconductor ASA
#
# SPDX-License-Identifier: Apache-2.0

config  BOARD_DCFURS_BT832A
	bool "DCFurs BT832A"
	depends on SOC_NRF52810_QFAA
```

## boards/arm/dcfurs_bt832a/Kconfig.defconfig
```kconfig
# Kconfig - nRF52810 PCA10040 board configuration
#
# Copyright (c) 2018 Nordic Semiconductor ASA
#
# SPDX-License-Identifier: Apache-2.0

if BOARD_DCFURS_BT832A

config BOARD
	default "dcfurs_bt832a"

if ADC

config ADC_0
	default y

endif # ADC

if I2C

config I2C_0
	default y

endif # I2C

if SPI

config SPI_0
	default y

endif # SPI

endif # BOARD_DCFURS_BT832A
```

## boards/arm/dcfurs_fox/Kconfig
```kconfig
# Kconfig - DCFurs fox beacon configuration
#
# Copyright (c) 2019 DEFCON Furs
#
# SPDX-License-Identifier: Apache-2.0

if BOARD_DCFURS_FOX

config BOARD_ENABLE_DCDC
	bool "Enable DCDC mode"
	select SOC_DCDC_NRF52X
	default y

endif # BOARD_DCFURS_FOX
```

## boards/arm/dcfurs_fox/Kconfig.board
```kconfig
# Kconfig - DCFurs Fox Beacon configuration
#
# Copyright (c) 2019 DEFCON Furs
#
# SPDX-License-Identifier: Apache-2.0

config  BOARD_DCFURS_FOX
	bool "DCFurs Fox Beacon"
	depends on SOC_NRF52832_QFAA
```

## boards/arm/dcfurs_fox/Kconfig.defconfig
```kconfig
# Kconfig - DCFurs Fox Beacon configuration
#
# Copyright (c) 2019 DEFCON Furs
#
# SPDX-License-Identifier: Apache-2.0

if BOARD_DCFURS_FOX

config BOARD
	default "dcfurs_fox"

config GPIO_AS_PINRESET
	default n

if I2C

config I2C_0
	default y

endif # I2C

config BT_CTLR
	default BT

endif # BOARD_DCFURS_FOX
```
